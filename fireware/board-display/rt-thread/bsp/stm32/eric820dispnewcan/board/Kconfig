## fireware/board-display/rt-thread/bsp/stm32/eric820dispnewcan/board/Kconfig
```kconfig
menu "Hardware Drivers Config"

menu "Onboard Peripheral Drivers"

    config BSP_USING_RS232_TO_USART
        bool "Enable RS232 TO USART (uart1)"
        select BSP_USING_UART
        select BSP_USING_UART1
        default n

    config BSP_USING_EXT_FMC_IO
        bool "Enable extend gpio"
        select BSP_USING_FMC
        default y

    config BSP_USING_SDRAM
        bool "Enable SDRAM"
        select BSP_USING_FMC
        default n

    config BSP_USING_SPI_FLASH
        bool "Enable SPI FLASH (W25Q256 spi3)"
        select BSP_USING_SPI
        select BSP_USING_SPI3
        select RT_USING_SFUD
        select RT_SFUD_USING_SFDP
        default n

    config BSP_USING_SDCARD
        bool "Enable SDCARD (sdio)"
        select BSP_USING_SDIO
        select RT_USING_DFS
        select RT_USING_DFS_ELMFAT
        default n

    config PHY_USING_DM9161CEP
        bool

    menuconfig BSP_USING_ETH
        bool "Enable Ethernet"
        select RT_USING_LWIP
        select PHY_USING_DM9161CEP
        default n
        if BSP_USING_ETH
            config PHY_USING_INTERRUPT_MODE
                bool "enable phy interrupt mode"
                select PHY_INT_PIN
                default n

            config PHY_INT_PIN
                int
                default 118
        endif

    config BSP_USING_LCD
        bool "Enable LCD"
        select BSP_USING_LTDC
        select BSP_USING_SDRAM
        select BSP_USING_PWM
        select BSP_USING_PWM1
        select BSP_USING_PWM1_CH4
        default n

    config BSP_USING_MPU6050
        bool "Enable MPU6050(i2c1)"
        select BSP_USING_I2C1
        select PKG_USING_MPU6XXX
        select PKG_USING_MPU6XXX_SAMPLE
        select PKG_USING_MPU6XXX_LATEST_VERSION
        default n
endmenu

menu "On-chip Peripheral Drivers"

    config BSP_USING_GPIO
        bool "Enable GPIO"
        select RT_USING_PIN
        default y

    menuconfig BSP_USING_UART
        bool "Enable UART"
        default y
        select RT_USING_SERIAL
        if BSP_USING_UART

	    config BSP_STM32_UART_V1_TX_TIMEOUT
                int "UART TX timeout"
                default 2000
                depends on RT_USING_SERIAL_V1

            config BSP_USING_UART1
                bool "Enable UART1"
                default y

                    config BSP_UART1_RX_USING_DMA
                        bool "Enable UART1 RX DMA"
                        depends on BSP_USING_UART1 && RT_SERIAL_USING_DMA
                        default n

                    config BSP_UART1_TX_USING_DMA
                        bool "Enable UART1 TX DMA"
                        depends on BSP_USING_UART1 && RT_SERIAL_USING_DMA
                        default n

                    config BSP_UART1_RX_BUFSIZE
                        int "Set UART1 RX buffer size"
                        range 64 65535
                        depends on RT_USING_SERIAL_V2
                        default 256

                    config BSP_UART1_TX_BUFSIZE
                        int "Set UART1 TX buffer size"
                        range 0 65535
                        depends on RT_USING_SERIAL_V2
                        default 0
        endif

        if BSP_USING_UART
            config BSP_USING_UART3
                bool "Enable UART3"
                default y

                    config BSP_UART3_RX_USING_DMA
                        bool "Enable UART3 RX DMA"
                        depends on BSP_USING_UART3 && RT_SERIAL_USING_DMA
                        default n

                    config BSP_UART3_TX_USING_DMA
                        bool "Enable UART3 TX DMA"
                        depends on BSP_USING_UART3 && RT_SERIAL_USING_DMA
                        default n

                    config BSP_UART3_RX_BUFSIZE
                        int "Set UART3 RX buffer size"
                        range 64 65535
                        depends on RT_USING_SERIAL_V2
                        default 256

                    config BSP_UART3_TX_BUFSIZE
                        int "Set UART3 TX buffer size"
                        range 0 65535
                        depends on RT_USING_SERIAL_V2
                        default 0
        endif

        if BSP_USING_UART
            config BSP_USING_UART7
                bool "Enable UART7"
                default y
                config BSP_UART7_RX_USING_DMA
                    bool "Enable UART7 RX DMA"
                    depends on BSP_USING_UART7 && RT_SERIAL_USING_DMA
                    default n

                config BSP_UART7_TX_USING_DMA
                    bool "Enable UART7 TX DMA"
                    depends on BSP_USING_UART7 && RT_SERIAL_USING_DMA
                    default n

                config BSP_UART7_RX_BUFSIZE
                    int "Set UART7 RX buffer size"
                    range 64 65535
                    depends on RT_USING_SERIAL_V2
                    default 256

                config BSP_UART7_TX_BUFSIZE
                    int "Set UART7 TX buffer size"
                    range 0 65535
                    depends on RT_USING_SERIAL_V2
                    default 0
        endif

        if BSP_USING_UART
            config BSP_USING_UART6
                bool "Enable UART6"
                default y

                config BSP_UART6_RX_USING_DMA
                    bool "Enable UART6 RX DMA"
                    depends on BSP_USING_UART6 && RT_SERIAL_USING_DMA
                    default n

                config BSP_UART6_TX_USING_DMA
                    bool "Enable UART6 TX DMA"
                    depends on BSP_USING_UART6 && RT_SERIAL_USING_DMA
                    default n

                config BSP_UART6_RX_BUFSIZE
                    int "Set UART6 RX buffer size"
                    range 64 65535
                    depends on RT_USING_SERIAL_V2
                    default 256

                config BSP_UART6_TX_BUFSIZE
                    int "Set UART6 TX buffer size"
                    range 0 65535
                    depends on RT_USING_SERIAL_V2
                    default 0
        endif

    config BSP_USING_ON_CHIP_FLASH
        bool "Enable on-chip FLASH"
        default n

    menuconfig BSP_USING_SPI
        bool "Enable SPI BUS"
        default n
        select RT_USING_SPI
        if BSP_USING_SPI
            config BSP_USING_SPI2
                bool "Enable SPI2 BUS"
                default n

            config BSP_SPI2_TX_USING_DMA
                bool "Enable SPI2 TX DMA"
                depends on BSP_USING_SPI2
                default n

            config BSP_SPI2_RX_USING_DMA
                bool "Enable SPI2 RX DMA"
                depends on BSP_USING_SPI2
                select BSP_SPI2_TX_USING_DMA
                default n

            config BSP_USING_SPI3
                bool "Enable SPI3 BUS"
                default n

            config BSP_SPI3_TX_USING_DMA
                bool "Enable SPI3 TX DMA"
                depends on BSP_USING_SPI3
                default n

            config BSP_SPI3_RX_USING_DMA
                bool "Enable SPI3 RX DMA"
                depends on BSP_USING_SPI3
                select BSP_SPI3_TX_USING_DMA
                default n

            config BSP_USING_SPI4
                bool "Enable SPI4 BUS"
                default n

            config BSP_SPI4_TX_USING_DMA
                bool "Enable SPI4 TX DMA"
                depends on BSP_USING_SPI4
                default n

            config BSP_SPI4_RX_USING_DMA
                bool "Enable SPI4 RX DMA"
                depends on BSP_USING_SPI4
                select BSP_SPI4_TX_USING_DMA
                default n
        endif

    menuconfig BSP_USING_I2C1
        bool "Enable I2C1 BUS (software simulation)"
        default n
        select RT_USING_I2C
        select RT_USING_I2C_BITOPS
        select RT_USING_PIN
        if BSP_USING_I2C1
            config BSP_I2C1_SCL_PIN
                int "i2c1 scl pin number"
                range 1 216
                default 22
            config BSP_I2C1_SDA_PIN
                int "I2C1 sda pin number"
                range 1 216
                default 25
        endif

    menuconfig BSP_USING_TIM
        bool "Enable timer"
        default n
        select RT_USING_HWTIMER
        if BSP_USING_TIM
            config BSP_USING_TIM11
                bool "Enable TIM11"
                default n

            config BSP_USING_TIM13
                bool "Enable TIM13"
                default n

            config BSP_USING_TIM14
                bool "Enable TIM14"
                default n
        endif

    menuconfig BSP_USING_PWM
        bool "Enable PWM"
        default n
        select RT_USING_PWM
        if BSP_USING_PWM
        menuconfig BSP_USING_PWM1
            bool "Enable timer1 output PWM"
            default n
            if BSP_USING_PWM1
                config BSP_USING_PWM1_CH4
                    bool "Enable PWM1 channel4"
                    default n
            endif
        endif
        if BSP_USING_PWM
        menuconfig BSP_USING_PWM12
            bool "Enable timer12 output PWM"
            default n
            if BSP_USING_PWM12
                config BSP_USING_PWM12_CH2
                    bool "Enable PWM12 channel2"
                    default n
            endif
        endif

    menuconfig BSP_USING_ADC
        bool "Enable ADC"
        default n
        select RT_USING_ADC
        if BSP_USING_ADC
            config BSP_USING_ADC1
                bool "Enable ADC1"
                default n
        endif

    menuconfig BSP_USING_ONCHIP_RTC
        bool "Enable RTC"
        select RT_USING_RTC
        default n
        if BSP_USING_ONCHIP_RTC
            choice
                prompt "Select clock source"
                default BSP_RTC_USING_LSE

                config BSP_RTC_USING_LSE
                    bool "RTC USING LSE"

                config BSP_RTC_USING_LSI
                    bool "RTC USING LSI"
            endchoice
        endif

    config BSP_USING_WDT
        bool "Enable Watchdog Timer"
        select RT_USING_WDT
        default n

    config BSP_USING_SDIO
        bool "Enable SDIO"
        select RT_USING_SDIO
        select RT_USING_DFS
        default n

    config BSP_USING_FMC
        bool
        default n

    config BSP_USING_LTDC
        bool
        default n
    source "$BSP_DIR/../libraries/HAL_Drivers/drivers/Kconfig"

endmenu

menu "Board extended module Drivers"

endmenu

endmenu
```
